## components/espressif__wasm-micro-runtime/build-scripts/esp-idf/wamr/Kconfig
```kconfig
menu "WASM Micro Runtime"
    choice WAMR_BUILD_TYPE
        prompt "Build type"
        default WAMR_BUILD_RELEASE

        config WAMR_BUILD_RELEASE
            bool "Release"

        config WAMR_BUILD_DEBUG
            bool "Debug"
    endchoice

    config WAMR_ENABLE_AOT
        bool "AOT"
        default y

    menuconfig WAMR_ENABLE_INTERP
        bool "Interpreter"
        default y

    if WAMR_ENABLE_INTERP

       choice WAMR_INTERP_MODE
            prompt "Interpreter mode"
            default WAMR_INTERP_FAST

            config WAMR_INTERP_CLASSIC
                bool "Classic"

            config WAMR_INTERP_FAST
                bool "Fast"
        endchoice

        choice WAMR_INTERP_LOADER_MODE
            prompt "Loader mode"
            default WAMR_INTERP_LOADER_NORMAL

            config WAMR_INTERP_LOADER_NORMAL
                bool "Normal"

            config WAMR_INTERP_LOADER_MINI
                bool "Mini"
        endchoice
    endif

    config WAMR_ENABLE_LIB_PTHREAD
        bool "Lib pthread"
        default y

    config WAMR_ENABLE_LIB_PTHREAD_SEMAPHORE
        bool "Lib pthread semaphore"
        default n
        depends on WAMR_ENABLE_LIB_PTHREAD

    config WAMR_ENABLE_LIBC_BUILTIN
        bool "Libc builtin"
        default y

    config WAMR_ENABLE_LIBC_WASI
        bool "Libc WASI"
        default y

    config WAMR_ENABLE_LIB_WASI_THREADS
        bool "Lib wasi-threads"
        default n
        depends on WAMR_ENABLE_LIBC_WASI

    config WAMR_ENABLE_BULK_MEMORY
        bool "Bulk memory"
        default y

    config WAMR_ENABLE_TAIL_CALL
        bool "Tail call"
        default n

    config WAMR_ENABLE_EXTENDED_CONST_EXPR
        bool "Extended const expressions"
        default n

    config WAMR_ENABLE_EXCE_HANDLING
        bool "Exception handling"
        default n

    config WAMR_ENABLE_MEMORY_PROFILING
        bool "Memory profiling"
        default n

    config WAMR_ENABLE_MULTI_MODULE
        bool "Multi module"
        default n

    config WAMR_ENABLE_PERF_PROFILING
        bool "Performance profiling"
        default n

    config WAMR_ENABLE_REF_TYPES
        bool "Reference types"
        default y

    config WAMR_ENABLE_SHARED_MEMORY
        bool "Shared memory"
        default n

    config WAMR_ENABLE_SHARED_HEAP
        bool "Shared heap"
        default n

    config WAMR_ENABLE_THREAD_MGR
        bool "Thread manager"
        default n

    config WAMR_ENABLE_CUSTOM_NAME_SECTION
        bool "Custom name section"
        default n

    config WAMR_ENABLE_DUMP_CALL_STACK
        bool "Dump call stack"
        default n

    config WAMR_ENABLE_LOAD_CUSTOM_SECTION
        bool "Load custom sections"
        default n

    config WAMR_ENABLE_DEBUG_INTERP
        bool "Debug interpreter"
        default n
        depends on WAMR_ENABLE_INTERP

    config WAMR_ENABLE_SHRUNK_MEMORY
        bool "Shrunk memory"
        default y

    menuconfig WAMR_ENABLE_APP_FRAMEWORK
        bool "App framework"
        default y

    if WAMR_ENABLE_APP_FRAMEWORK

        config WAMR_APP_THREAD_STACK_SIZE_MAX
            int "Application thread max stack size"
            default 131072
    endif
endmenu
```

## components/espressif__wasmachine_core/Kconfig.projbuild
```kconfig
menu "WASMachine Configuration"
    orsource "../wasmachine_core/Kconfig.wasmachine"
    orsource "../espressif__wasmachine_core/Kconfig.wasmachine"
    orsource "../wasmachine_shell/Kconfig.wasmachine"
    orsource "../espressif__wasmachine_shell/Kconfig.wasmachine"
endmenu
```

## components/espressif__wasmachine_core/Kconfig.wasmachine
```kconfig
menu "Generic"
    config WASMACHINE_FILE_SYSTEM_BASE_PATH
        string "File-system base path"
        default "/storage"
endmenu
```

## components/mpy/Kconfig
```kconfig
menu "MicroPython Interpreter Configuration"

    config ENABLE_TESTS
        bool "Enable tests"
        default n
        help
            This option enables tests in the MicroPython interpreter.

endmenu
```

## main/Kconfig.projbuild
```kconfig
menu "FTP Service"

config FTP_SVC_USER
    string "FTP server username"
    default "root"

config FTP_SVC_PASSWORD
    string "FTP server password"
    default "root"

endmenu
```
